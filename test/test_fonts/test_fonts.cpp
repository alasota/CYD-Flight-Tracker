// The display fonts in src/fonts/lcars_efont.c (subsets generated by
// tools/subset_efont.py) against the character set the rest of the firmware
// is allowed to draw (isFontSafeText() / isFontCodepoint()).
#include <unity.h>

#include <cstdio>
#include <initializer_list>

#include "fonts/lcars_efont.h"
#include "lcars_theme.h"

void setUp(void) {}
void tearDown(void) {}

namespace {

struct Font {
  const char *name;
  const uint8_t *data;
};
const Font kFonts[] = {{"efont_16", lcars_efont_16},
                       {"efont_14", lcars_efont_14},
                       {"efont_10", lcars_efont_10}};

}  // namespace

static void test_every_allowed_character_has_a_glyph_in_every_font(void) {
  int allowed = 0;
  for (uint32_t cp = 0; cp <= 0xFFFF; ++cp) {
    if (!isFontCodepoint(cp)) continue;
    ++allowed;
    for (const Font &f : kFonts) {
      char msg[48];
      snprintf(msg, sizeof(msg), "%s lacks U+%04X", f.name, static_cast<unsigned>(cp));
      TEST_ASSERT_TRUE_MESSAGE(fontHasGlyph(f.data, static_cast<uint16_t>(cp)), msg);
    }
  }
  TEST_ASSERT_EQUAL_INT(95 + 18 + 8, allowed);  // ASCII + Polish + ° ± × · – — … →
}

static void test_fonts_hold_nothing_else(void) {
  // A few characters the original efontJA fonts had and the subsets dropped.
  const uint16_t dropped[] = {0x00FC /* ü */, 0x00E9 /* é */, 0x20AC /* € */, 0x3042 /* あ */,
                              0x65E5 /* 日 */};
  for (const Font &f : kFonts) {
    for (uint16_t cp : dropped) TEST_ASSERT_FALSE(fontHasGlyph(f.data, cp));
  }
}

static void test_metrics_match_the_original_efont(void) {
  // Header bytes 1..16 (bbx mode, bit widths, max glyph size, offsets,
  // ascent/descent) copied from LovyanGFX's efontJA_16 / _14 / _10 — they
  // set line height and baseline, so the layout must not move.
  const uint8_t h16[] = {0x00, 0x03, 0x02, 0x05, 0x05, 0x05, 0x05, 0x06,
                         0x10, 0x10, 0x00, 0xfe, 0x0a, 0xfe, 0x0b, 0xff};
  TEST_ASSERT_EQUAL_HEX8_ARRAY(h16, lcars_efont_16 + 1, sizeof(h16));
  TEST_ASSERT_EQUAL_INT(16, lcars_efont_16[10]);  // max_char_height
  TEST_ASSERT_EQUAL_INT(14, lcars_efont_14[10]);
  TEST_ASSERT_EQUAL_INT(10, lcars_efont_10[10]);
}

static void test_ascii_lookup_starting_points_are_valid(void) {
  // 'A' and 'a' are reached through header shortcuts — check both ends of
  // each range and the first non-ASCII glyphs right after them.
  for (const Font &f : kFonts) {
    for (uint16_t cp : {uint16_t(' '), uint16_t('@'), uint16_t('A'), uint16_t('Z'),
                        uint16_t('`'), uint16_t('a'), uint16_t('z'), uint16_t('~'),
                        uint16_t(0x00B0), uint16_t(0x00F3), uint16_t(0x0104), uint16_t(0x2192)}) {
      TEST_ASSERT_TRUE(fontHasGlyph(f.data, cp));
    }
  }
}

static void test_font_safe_text_accepts_the_new_symbols(void) {
  TEST_ASSERT_TRUE(isFontSafeText("20\xC2\xB0"));                 // 20°
  TEST_ASSERT_TRUE(isFontSafeText("\xC2\xB1" "5 km"));             // ±5 km
  TEST_ASSERT_TRUE(isFontSafeText("A \xE2\x80\x93 B"));            // en dash
  TEST_ASSERT_TRUE(isFontSafeText("WAW \xE2\x86\x92 FCO"));        // →
  TEST_ASSERT_TRUE(isFontSafeText("LOT\xE2\x80\xA6"));             // …
  TEST_ASSERT_FALSE(isFontSafeText("\xE2\x82\xAC"));               // € — not in the fonts
  TEST_ASSERT_FALSE(isFontSafeText("\xE2\x86"));                   // truncated UTF-8
  TEST_ASSERT_FALSE(isFontSafeText("\xF0\x9F\x9B\xA9"));           // emoji (4-byte)
  TEST_ASSERT_FALSE(isFontSafeText("\x80"));                       // stray continuation byte
}

int main(int argc, char **argv) {
  UNITY_BEGIN();
  RUN_TEST(test_every_allowed_character_has_a_glyph_in_every_font);
  RUN_TEST(test_fonts_hold_nothing_else);
  RUN_TEST(test_metrics_match_the_original_efont);
  RUN_TEST(test_ascii_lookup_starting_points_are_valid);
  RUN_TEST(test_font_safe_text_accepts_the_new_symbols);
  return UNITY_END();
}
